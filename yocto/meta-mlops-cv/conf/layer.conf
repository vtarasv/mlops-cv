## yocto/meta-mlops-cv/conf/layer.conf
```bitbake
BBPATH .= ":${LAYERDIR}"
BBFILES += "${LAYERDIR}/recipes-*/*/*.bb ${LAYERDIR}/recipes-*/*/*.bbappend"

BBFILE_COLLECTIONS += "mlops-cv"
BBFILE_PATTERN_mlops-cv = "^${LAYERDIR}/"
BBFILE_PRIORITY_mlops-cv = "10"
LAYERDEPENDS_mlops-cv = "core raspberrypi"
LAYERSERIES_COMPAT_mlops-cv = "wrynose"
```
